## meta/meta-gplv2/conf/layer.conf
```bitbake
# We have a conf and classes directory, add to BBPATH
BBPATH .= ":${LAYERDIR}"

# We have recipes-* directories, add to BBFILES
BBFILES += "${LAYERDIR}/recipes-*/*/*.bb"

BBFILE_COLLECTIONS += "gplv2"
BBFILE_PATTERN_gplv2 = "^${LAYERDIR}/"
BBFILE_PRIORITY_gplv2 = "1"

# This should only be incremented on significant changes that will
# cause compatibility issues with other layers
LAYERVERSION_gplv2 = "1"

LAYERDEPENDS_gplv2 = "core"
```

## meta/meta-mediatek-aud/conf/layer.conf
```bitbake
# We have a conf and classes directory, add to BBPATH
BBPATH .= ":${LAYERDIR}"

# We have a packages directory, add to BBFILES
BBFILES += "${LAYERDIR}/recipes-*/*/*.bb \
            ${LAYERDIR}/recipes-*/*/*.bbappend"

BBFILE_COLLECTIONS += "mediatek-aud"
BBFILE_PATTERN_mediatek-aud := "^${LAYERDIR}/"
BBFILE_PRIORITY_mediatek-aud = "10"
```

## meta/meta-mediatek-mt8516/conf/layer.conf
```bitbake
# We have a conf and classes directory, add to BBPATH
BBPATH .= ":${LAYERDIR}"

# We have a packages directory, add to BBFILES
BBFILES += "${LAYERDIR}/recipes-*/*/*.bb \
            ${LAYERDIR}/recipes-*/*/*.bbappend"

BBFILE_COLLECTIONS += "mediatek-mt8516"
BBFILE_PATTERN_mediatek-mt8516 := "^${LAYERDIR}/"
BBFILE_PRIORITY_mediatek-mt8516 = "10"
```

## meta/meta-mediatek-mt8516/conf/machine/aud8516-ztk-basic.conf
```bitbake
#@TYPE: Machine
#@NAME:mt8516evb
#@DESCRIPTION: Machine configuration for mt8516

# For building codes by aarch64 mode (default 64-bit mode).
DEFAULTTUNE ?= "aarch64"
TUNE_CCARGS .= "${@bb.utils.contains('TUNE_FEATURES', 'aarch64', ' -mcpu=cortex-a72.cortex-a53+crypto', '', d)}"
TUNE_CCARGS .= "${@bb.utils.contains('TUNE_FEATURES', 'aarch64', ' -mtune=cortex-a72.cortex-a53', '', d)}"
# include conf/machine/include/arm/arch-armv8.inc
require arch-arm64-tune-cortexa7-multilib.inc
# require conf/machine/include/arm/arch-armv7ve.inc
# require arch-arm64-tune-armv7ve-multilib.inc

# For building codes by aarch32 mode (32-bit mode) when all modules are ready for armv8.
# TUNE_CCARGS .= "${@bb.utils.contains('TUNE_FEATURES', 'aarch32', ' -mcpu=cortex-a72.cortex-a53', '', d)}"
# TUNE_CCARGS .= "${@bb.utils.contains('TUNE_FEATURES', 'aarch32', ' -mtune=cortex-a72.cortex-a53', '', d)}"
# TUNE_CCARGS .= "${@bb.utils.contains('TUNE_FEATURES', 'aarch32', ' -mfpu=crypto-neon-fp-armv8', '', d)}"
# TUNE_CCARGS .= "${@bb.utils.contains('TUNE_FEATURES', 'aarch32', ' -mfloat-abi=softfp', '', d)}"
# require conf/multilib.conf
# DEFAULTTUNE_virtclass-multilib-lib32 = "aarch32"

# For building codes by armv7ve mode (latest armv7 32-bit mode)
# TUNE_CCARGS .= "${@bb.utils.contains('TUNE_FEATURES', 'armv7ve', ' -mcpu=cortex-a72.cortex-a53', '', d)}" # Fine tune mcpu in the future.
# TUNE_CCARGS .= "${@bb.utils.contains('TUNE_FEATURES', 'armv7ve', ' -mtune=cortex-a72.cortex-a53', '', d)}"
# require conf/multilib.conf
# DEFAULTTUNE_virtclass-multilib-lib32 = "armv7vehf-neon-vfpv4"

# For building codes to sync with other projects.
require conf/multilib.conf
DEFAULTTUNE_virtclass-multilib-lib32 = "cortexa7hf-neon-vfpv4"

# project
MTK_PROJECT = "aud8516-ztk-basic"
TARGET_PLATFORM = "mt8516"
PRJ_FILENAME = "${MTK_PROJECT}"
COMPLIST = "${LINUX_KERNEL}"
LINUX_KERNEL = "linux-4.4.22"
PLATFORM_CHIP="MT8516"
PLATFORM="${TARGET_PLATFORM}"


# Preloader
#PRELOADER_PROJECT = "aud8516"

# LK
LK_PROJECT = "${MTK_PROJECT}"
FULL_PROJECT = "full_${MTK_PROJECT}"
PREFERRED_VERSION_lk = "2.0.0"
BOOTDEV_TYPE = "nand"
NAND_CHIP_NAME = "MX30LF1G18AC"
#nand brom header version:
#        1.0 or null: header sytle of mt8590, which is independent of PMBR
#        1.1: header style of mt8167
#        2.0: header style of mt2712, which is designed for GPT, and is part of PMBR
NAND_HEADER_VERSION = "1.1"

# secure boot
SECURE_BOOT_ENABLE = "no"
MTK_KEY_DIR = "${TOPDIR}/../meta/meta-mediatek/conf/machine/keys"
SBC_KEY = "sbc_key"
VERIFIED_KEY = "verified_key"
MTEE_KEY = "mtee_key"
FORCE_DISABLE_DM_VERITY = "yes"
FORCE_DISABLE_TEE_ENCRYPTION = "yes"
ENABLE_MTD_VERITY = "yes"

# Trustzone
TZ_PROJECT = "aud8516"
TZ_PLATFORM = "mt8516"
ATF_SUPPORT = "yes"
PREFERRED_VERSION_atf = "1.21"
ATF_INSTALL_MODE = "debug"
MTK_MACH_TYPE = "mt8516"
TRUSTZONE_HEADER = "fit"
TRUSTZONE_COMPRESS = "none"
TEE_SUPPORT = "mtee"
TRUSTZONE_ENTRYPOINT = "0x43001000"
TRUSTZONE_LOADADDRESS = "0x43001000"
TRUSTEDOS_ENTRYPOINT = "0x47D00000"
TRUSTEDOS_LOADADDRESS = "0x47D00000"

# Kernel
KERNEL_ARCH = "arm64"
PREFERRED_PROVIDER_virtual/kernel = "linux-mtk-extension"
PREFERRED_VERSION_linux-mtk-extension ?= "4.4%"
KERNEL_IMAGETYPE = "fitImage"
# for 6627
KBUILD_DEFCONFIG = "aud8516p1v2_consys_slc_yocto_defconfig"
KERNEL_DEVICETREE = "aud8516_ztk_basic_yocto.dtb"
DTB_LOADADDRESS = "0x44000000"
KERNEL_COMPRESS = "lz4"
OLDEST_KERNEL = "3.18"

# LOADER ENTRYPOINT, LOADADDRESS
UBOOT_ENTRYPOINT = "0x40080000"
UBOOT_LOADADDRESS = "0x40080000"

# Scatter File
SCATTER_PROJECT = "${MACHINE}"

# GPU
PREFERRED_VERSION_mali ?= "midgard-r13p0"
PREFERRED_PROVIDER_virtual/egl = "mali"
PREFERRED_PROVIDER_virtual/libgles1 = "mali"
PREFERRED_PROVIDER_virtual/libgles2 = "mali"
PREFERRED_PROVIDER_virtual/libgl = "mali"
PREFERRED_PROVIDER_virtual/mesa = "mali"
PREFERRED_VERSION_systemd = "300"
PREFERRED_VERSION_alsa-utils = "2.1.0"

# Image FS
IMAGE_FSTYPES ?= "ubi"
IMAGE_ROOTFS_ALIGNMENT = "4"
EXTRA_IMAGEDEPENDS += "lk trustzone scatter"
SERIAL_CONSOLE = "921600 ttyMT0"

# UBIFS
MTK_UBIFS_SUPPORT="yes"
MKUBIFS_ARGS="-x zlib -m 2048 -e 126976 -c 353 -F"
MKUBIFS_USRDATA_VOL_SZ="15MiB"
MKUBIFS_USRDATA_IMAGE_SZ="2048"
MKUBIFS_USRDATA_ARGS="-x zlib -m 2048 -e 126976 -c 127 -F"
UBINIZE_ARGS="-m 2048 -p 128KiB -s 2048 -O 2048"

#COMBO CHIP
COMBO_CHIP_ID="mt8167"
#BT LAUNCHER SUFFIX
BT_LAUNCHER_SUFFIX="6627_"
BLE_ENABLE="yes"
#WIFI LAUNCHER SUFFIX
# for 6630
#WIFI_LAUNCHER_SUFFIX=""
# for 6627
WIFI_LAUNCHER_SUFFIX="_6627"

ALGO_WENZHI="yes"
#ADC TYPE
ADC_SETTING = "es7243"
```

## meta/meta-mediatek/conf/layer.conf
```bitbake
# We have a conf and classes directory, add to BBPATH
BBPATH .= ":${LAYERDIR}"

# We have a recipes-* directories, add to BBFILES
BBFILES += "${LAYERDIR}/recipes-*/*/*.bb \
	${LAYERDIR}/recipes-*/*/*.bbappend"

BBFILE_COLLECTIONS += "mediatek"
BBFILE_PATTERN_mediatek = "^${LAYERDIR}/"
BBFILE_PRIORITY_mediatek = "8"
LICENSE_PATH += "${LAYERDIR}/files/additional-licenses"
```
