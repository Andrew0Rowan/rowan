;EMI setting
D.S SD:0x10203068 %LE %LONG 0x100000;
D.S SD:0x10203060 %LE %LONG 0xff000400;
;D.S SD:0x10203000 %LE %LONG 0x50535052;
;D.S SD:0x10203000 %LE %LONG 0x50535152;
;D.S SD:0x10105000 %LE %LONG 0x5053;
D.S SD:0x10203000 %LE %LONG 0x50525052;
D.S SD:0x10105000 %LE %LONG 0x5053;
D.S SD:0x10105010 %LE %LONG 0x1;
;;D.S SD:0x1020d000 %LE %LONG 0x5053;
;;D.S SD:0x1020d010 %LE %LONG 0x1;

;DDRPHY setting
D.S SD:0x10100110 %LE %LONG 0x03051192;
D.S SD:0x10100048 %LE %LONG 0x0001110d;
D.S SD:0x101000D8 %LE %LONG 0x00500900;
D.S SD:0x101000E4 %LE %LONG 0x00000000;
D.S SD:0x1010008c %LE %LONG 0x00000001;
D.S SD:0x10100090 %LE %LONG 0x00000000;
D.S SD:0x10100094 %LE %LONG 0x80000000;
D.S SD:0x101000DC %LE %LONG 0x83020020;
D.S SD:0x101000E0 %LE %LONG 0x01020020;
D.S SD:0x101000F0 %LE %LONG 0x00000000;
D.S SD:0x101000F4 %LE %LONG 0x11000000;
D.S SD:0x10100168 %LE %LONG 0x00000080;
D.S SD:0x101000D8 %LE %LONG 0x00700900;
;D.S SD:0x10100004 %LE %LONG 0xF00487A2;
D.S SD:0x10100004 %LE %LONG 0xF00482A2;
;D.S SD:0x1010007C %LE %LONG 0x900641c0;
D.S SD:0x1010007C %LE %LONG 0xa00641f0;
D.S SD:0x10100028 %LE %LONG 0xF1200F01;
D.S SD:0x101001E0 %LE %LONG 0x3001ebff;
D.S SD:0x10100158 %LE %LONG 0x00000000;
D.S SD:0x101000e4 %LE %LONG 0x00000005;
wait 1.ms
D.S SD:0x10100088 %LE %LONG 0x0000003F;
D.S SD:0x101001E4 %LE %LONG 0x00000001;
D.S SD:0x101001E4 %LE %LONG 0x00000000;
wait 1.ms
D.S SD:0x10100088 %LE %LONG 0x00FF000A;
D.S SD:0x101001E4 %LE %LONG 0x00000001;
D.S SD:0x101001E4 %LE %LONG 0x00000000;
wait 1.ms
D.S SD:0x10100088 %LE %LONG 0x00330001;
D.S SD:0x101001E4 %LE %LONG 0x00000001;
D.S SD:0x101001E4 %LE %LONG 0x00000000;
wait 1.ms
D.S SD:0x10100088 %LE %LONG 0x00040002;
D.S SD:0x101001E4 %LE %LONG 0x00000001;
D.S SD:0x101001E4 %LE %LONG 0x00001100;
wait 1.ms
;D.S SD:0x10100110 %LE %LONG 0x00111190;
D.S SD:0x101000E4 %LE %LONG 0x00000001;
D.S SD:0x10100084 %LE %LONG 0x00000a56;
D.S SD:0x1010000C %LE %LONG 0x00000000;
;D.S SD:0x10100000 %LE %LONG 0x45D84408;
D.S SD:0x10100000 %LE %LONG 0x45D84a08;
D.S SD:0x10100044 %LE %LONG 0xa8080401;
D.S SD:0x101001E8 %LE %LONG 0x00000510;
D.S SD:0x10100008 %LE %LONG 0x03406340;
D.S SD:0x10100010 %LE %LONG 0x00000000;
D.S SD:0x101000F8 %LE %LONG 0xEDCB000F;
D.S SD:0x101000FC %LE %LONG 0x27010000;

;DMARB
;D.S SD:0x10206040 %LE %LONG 0x00000010;

;DRAMC setting
;if &NR_RNKS==2
;(
D.S SD:0x10102110 %LE %LONG 0x03051192;
D.S SD:0x10102124 %LE %LONG 0xaa080000;
D.S SD:0x10102118 %LE %LONG 0x00000001;
;)
;else
;(
;D.S SD:0x10102110 %LE %LONG 0x00051180;
;)
D.S SD:0x10102048 %LE %LONG 0x0001110d;
D.S SD:0x101020D8 %LE %LONG 0x00500900;
D.S SD:0x101020E4 %LE %LONG 0x00000000;
D.S SD:0x1010208c %LE %LONG 0x00000001;
D.S SD:0x10102090 %LE %LONG 0x00000000;
D.S SD:0x10102094 %LE %LONG 0x80000000;
D.S SD:0x10102000 %LE %LONG 0x45d94a08;
D.S SD:0x10102004 %LE %LONG 0xf00482a2;
D.S SD:0x1010207C %LE %LONG 0xa00652f0;
;D.S SD:0x101020DC %LE %LONG 0x83004004;
;D.S SD:0x101020E0 %LE %LONG 0x01004004;
D.S SD:0x101020DC %LE %LONG 0x83020020;
D.S SD:0x101020E0 %LE %LONG 0x01020020;
D.S SD:0x101020F0 %LE %LONG 0x00000000;
D.S SD:0x101020F4 %LE %LONG 0x11000000;
D.S SD:0x10102168 %LE %LONG 0x00000080;
D.S SD:0x101020D8 %LE %LONG 0x00700900;
D.S SD:0x10102028 %LE %LONG 0xF1200F01;
D.S SD:0x101021E0 %LE %LONG 0x3001ebff;
D.S SD:0x10102158 %LE %LONG 0x00000000;
D.S SD:0x101020e4 %LE %LONG 0x00000005;
;wait 1.ms
D.S SD:0x10102088 %LE %LONG 0x0000003F;
D.S SD:0x101021E4 %LE %LONG 0x00000001;
D.S SD:0x101021E4 %LE %LONG 0x00000000;
D.S SD:0x101021E4 %LE %LONG 0x00000000;
D.S SD:0x101021E4 %LE %LONG 0x00000000;
D.S SD:0x101021E4 %LE %LONG 0x00000000;
D.S SD:0x101021E4 %LE %LONG 0x00000000;
D.S SD:0x101021E4 %LE %LONG 0x00000000;
D.S SD:0x101021E4 %LE %LONG 0x00000000;
D.S SD:0x101021E4 %LE %LONG 0x00000000;
D.S SD:0x101021E4 %LE %LONG 0x00000000;
D.S SD:0x101021E4 %LE %LONG 0x00000000;
;wait 1.ms
D.S SD:0x10102088 %LE %LONG 0x00FF000A;
D.S SD:0x101021E4 %LE %LONG 0x00000001;
D.S SD:0x101021E4 %LE %LONG 0x00000000;
D.S SD:0x101021E4 %LE %LONG 0x00000000;
D.S SD:0x101021E4 %LE %LONG 0x00000000;
D.S SD:0x101021E4 %LE %LONG 0x00000000;
D.S SD:0x101021E4 %LE %LONG 0x00000000;
D.S SD:0x101021E4 %LE %LONG 0x00000000;
D.S SD:0x101021E4 %LE %LONG 0x00000000;
D.S SD:0x101021E4 %LE %LONG 0x00000000;
D.S SD:0x101021E4 %LE %LONG 0x00000000;
D.S SD:0x101021E4 %LE %LONG 0x00000000;
;wait 1.ms
D.S SD:0x10102088 %LE %LONG 0x00330001;
D.S SD:0x101021E4 %LE %LONG 0x00000001;
D.S SD:0x101021E4 %LE %LONG 0x00000000;
D.S SD:0x101021E4 %LE %LONG 0x00000000;
D.S SD:0x101021E4 %LE %LONG 0x00000000;
D.S SD:0x101021E4 %LE %LONG 0x00000000;
D.S SD:0x101021E4 %LE %LONG 0x00000000;
D.S SD:0x101021E4 %LE %LONG 0x00000000;
D.S SD:0x101021E4 %LE %LONG 0x00000000;
D.S SD:0x101021E4 %LE %LONG 0x00000000;
D.S SD:0x101021E4 %LE %LONG 0x00000000;
D.S SD:0x101021E4 %LE %LONG 0x00000000;
;wait 1.ms
D.S SD:0x10102088 %LE %LONG 0x00040002;
D.S SD:0x101021E4 %LE %LONG 0x00000001;
D.S SD:0x101021E4 %LE %LONG 0x00001100;
D.S SD:0x101021E4 %LE %LONG 0x00000000;
D.S SD:0x101021E4 %LE %LONG 0x00000000;
D.S SD:0x101021E4 %LE %LONG 0x00000000;
D.S SD:0x101021E4 %LE %LONG 0x00000000;
D.S SD:0x101021E4 %LE %LONG 0x00000000;
D.S SD:0x101021E4 %LE %LONG 0x00000000;
D.S SD:0x101021E4 %LE %LONG 0x00000000;
D.S SD:0x101021E4 %LE %LONG 0x00000000;
D.S SD:0x101021E4 %LE %LONG 0x00000000;
;wait 1.ms
;D.S SD:0x10102110 %LE %LONG 0x00111190;
;D.S SD:0x101020E4 %LE %LONG 0x00000001;
D.S SD:0x10102084 %LE %LONG 0x00000a56;
D.S SD:0x1010200C %LE %LONG 0x00000000;
;D.S SD:0x10102000 %LE %LONG 0x45D84408;
D.S SD:0x10102044 %LE %LONG 0xa8080401;
D.S SD:0x101021E8 %LE %LONG 0x00000510;
D.S SD:0x10102008 %LE %LONG 0x03406340;
D.S SD:0x10102010 %LE %LONG 0x00000000;
D.S SD:0x101020F8 %LE %LONG 0xEDCB000F;
D.S SD:0x101020FC %LE %LONG 0x27010000;
