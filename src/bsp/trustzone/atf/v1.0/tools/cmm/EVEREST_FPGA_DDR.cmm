D.S SD:0x10203060 %LE %LONG 0x00000400;
D.S SD:0x10203000 %LE %LONG 0x00025002; EMI_CONA , single channel/dual rank
D.S SD:0x1000407c %LE %LONG 0x80831081;
D.S SD:0x1001307c %LE %LONG 0x80831081;
D.S SD:0x10004054 %LE %LONG 0x00000100;
D.S SD:0x10013054 %LE %LONG 0x00000100;
D.S SD:0x1000f014 %LE %LONG 0x000007fe;
D.S SD:0x10012014 %LE %LONG 0x000007fe;
D.S SD:0x1000f018 %LE %LONG 0x00001010;
D.S SD:0x10012018 %LE %LONG 0x00001010;
D.S SD:0x1000f01c %LE %LONG 0x01100000;
D.S SD:0x1001201c %LE %LONG 0x01100000;
D.S SD:0x1000f020 %LE %LONG 0x010c1011;
D.S SD:0x10012020 %LE %LONG 0x010c1011;
D.S SD:0x1000f01c %LE %LONG 0x03100000;
D.S SD:0x1001201c %LE %LONG 0x03100000;
D.S SD:0x1000f03c %LE %LONG 0x00001010;
D.S SD:0x1001203c %LE %LONG 0x00001010;
D.S SD:0x1000f058 %LE %LONG 0x00001010;
D.S SD:0x10012058 %LE %LONG 0x00001010;
D.S SD:0x1000f074 %LE %LONG 0x000007fe;
D.S SD:0x10012074 %LE %LONG 0x000007fe;
D.S SD:0x1000f078 %LE %LONG 0x00001010;
D.S SD:0x10012078 %LE %LONG 0x00001010;
D.S SD:0x1000f07c %LE %LONG 0x01111010;
D.S SD:0x1001207c %LE %LONG 0x01111010;
D.S SD:0x1000f080 %LE %LONG 0x010c1011;
D.S SD:0x10012080 %LE %LONG 0x010c1011;
D.S SD:0x1000f07c %LE %LONG 0x03111010;
D.S SD:0x1001207c %LE %LONG 0x03111010;
D.S SD:0x1000f09c %LE %LONG 0x00001010;
D.S SD:0x1001209c %LE %LONG 0x00001010;
D.S SD:0x1000f0b8 %LE %LONG 0x00001010;
D.S SD:0x100120b8 %LE %LONG 0x00001010;
D.S SD:0x1000f180 %LE %LONG 0x00000000;
D.S SD:0x10012180 %LE %LONG 0x00000000;
D.S SD:0x1000f184 %LE %LONG 0x00000010;
D.S SD:0x10012184 %LE %LONG 0x00000010;
D.S SD:0x1000f188 %LE %LONG 0x000002e2;
D.S SD:0x10012188 %LE %LONG 0x000002e2;
D.S SD:0x1000f400 %LE %LONG 0x00000020;
D.S SD:0x10012400 %LE %LONG 0x00000020;
D.S SD:0x1000f404 %LE %LONG 0x00000000;
D.S SD:0x10012404 %LE %LONG 0x00000000;
D.S SD:0x1000f408 %LE %LONG 0x00000000;
D.S SD:0x10012408 %LE %LONG 0x00000000;
D.S SD:0x1000f40c %LE %LONG 0x00000000;
D.S SD:0x1001240c %LE %LONG 0x00000000;
D.S SD:0x1000f410 %LE %LONG 0x00000000;
D.S SD:0x10012410 %LE %LONG 0x00000000;
D.S SD:0x1000f414 %LE %LONG 0x00000000;
D.S SD:0x10012414 %LE %LONG 0x00000000;
D.S SD:0x1000f418 %LE %LONG 0x00000000;
D.S SD:0x10012418 %LE %LONG 0x00000000;
D.S SD:0x1000f41c %LE %LONG 0x00000000;
D.S SD:0x1001241c %LE %LONG 0x00000000;
D.S SD:0x1000f420 %LE %LONG 0xaa000040;
D.S SD:0x10012420 %LE %LONG 0xaa000040;
D.S SD:0x1000f424 %LE %LONG 0x00000000;
D.S SD:0x10012424 %LE %LONG 0x00000000;
D.S SD:0x1000f428 %LE %LONG 0x00000000;
D.S SD:0x10012428 %LE %LONG 0x00000000;
D.S SD:0x1000f42c %LE %LONG 0x00000000;
D.S SD:0x1001242c %LE %LONG 0x00000000;
D.S SD:0x1000f430 %LE %LONG 0xffff0000;
D.S SD:0x10012430 %LE %LONG 0xffff0000;
D.S SD:0x1000f434 %LE %LONG 0xffff0000;
D.S SD:0x10012434 %LE %LONG 0xffff0000;
D.S SD:0x1000f438 %LE %LONG 0x00000d0d;
D.S SD:0x10012438 %LE %LONG 0x00000d0d;
D.S SD:0x1000f43c %LE %LONG 0x00660600;
D.S SD:0x1001243c %LE %LONG 0x00660600;
D.S SD:0x1000f440 %LE %LONG 0x00660600;
D.S SD:0x10012440 %LE %LONG 0x00660600;
D.S SD:0x1000f444 %LE %LONG 0x80690600;
D.S SD:0x10012444 %LE %LONG 0x80690600;
D.S SD:0x1000f448 %LE %LONG 0xc0690600;
D.S SD:0x10012448 %LE %LONG 0xc0690600;
D.S SD:0x1000f44c %LE %LONG 0x00000000;
D.S SD:0x1001244c %LE %LONG 0x00000000;
D.S SD:0x1000f450 %LE %LONG 0x00000000;
D.S SD:0x10012450 %LE %LONG 0x00000000;
D.S SD:0x1000f454 %LE %LONG 0x00000000;
D.S SD:0x10012454 %LE %LONG 0x00000000;
D.S SD:0x1000f458 %LE %LONG 0x00100000;
D.S SD:0x10012458 %LE %LONG 0x00100000;
D.S SD:0x1000f5c0 %LE %LONG 0x0000000c;
D.S SD:0x100125c0 %LE %LONG 0x0000010c;
D.S SD:0x1000f460 %LE %LONG 0x00001010;
D.S SD:0x10012460 %LE %LONG 0x00001010;
D.S SD:0x1000f468 %LE %LONG 0x00001010;
D.S SD:0x10012468 %LE %LONG 0x00001010;
D.S SD:0x1000f454 %LE %LONG 0x00000000;
D.S SD:0x10012454 %LE %LONG 0x00000000;
D.S SD:0x1000f454 %LE %LONG 0x00010000;
D.S SD:0x10012454 %LE %LONG 0x00010000;
D.S SD:0x1000f404 %LE %LONG 0x80000000;
D.S SD:0x10012404 %LE %LONG 0x80000000;
D.S SD:0x1000f438 %LE %LONG 0x00008d8d;
D.S SD:0x10012438 %LE %LONG 0x00008d8d;
D.S SD:0x1000f43c %LE %LONG 0x00660e00;
D.S SD:0x1001243c %LE %LONG 0x00660e00;
D.S SD:0x1000f440 %LE %LONG 0x00660e00;
D.S SD:0x10012440 %LE %LONG 0x00660e00;
D.S SD:0x1000f444 %LE %LONG 0x80690e00;
D.S SD:0x10012444 %LE %LONG 0x80690e00;
D.S SD:0x1000f448 %LE %LONG 0xc0690e00;
D.S SD:0x10012448 %LE %LONG 0xc0690e00;
D.S SD:0x10004430 %LE %LONG 0x11f111ff;
D.S SD:0x10013430 %LE %LONG 0x11f111ff;
D.S SD:0x10004434 %LE %LONG 0xf0f0f0ff;
D.S SD:0x10013434 %LE %LONG 0xf0f0f0ff;
;D.S SD:0x10004438 %LE %LONG 0xffffffff;
;D.S SD:0x10013438 %LE %LONG 0xffffffff;
D.S SD:0x10004438 %LE %LONG 0xf1f1f1f1;
D.S SD:0x10013438 %LE %LONG 0xf1f1f1f1;
D.S SD:0x1000443c %LE %LONG 0x0000001f;
D.S SD:0x1001343c %LE %LONG 0x0000001f;

D.S SD:0x10004448 %LE %LONG 0x33333333;
D.S SD:0x10013448 %LE %LONG 0x33333333;

D.S SD:0x10004400 %LE %LONG 0x00000000;
D.S SD:0x10013400 %LE %LONG 0x00000000;
D.S SD:0x10004404 %LE %LONG 0x00201000;
D.S SD:0x10013404 %LE %LONG 0x00201000;
;D.S SD:0x10004418 %LE %LONG 0x00000228;
;D.S SD:0x10013418 %LE %LONG 0x00000228;
D.S SD:0x10004418 %LE %LONG 0x00000218;
D.S SD:0x10013418 %LE %LONG 0x00000218;
D.S SD:0x10004408 %LE %LONG 0x00000000;
D.S SD:0x10013408 %LE %LONG 0x00000000;
D.S SD:0x1000440c %LE %LONG 0x00000000;
D.S SD:0x1001340c %LE %LONG 0x00000000;
D.S SD:0x10004410 %LE %LONG 0x06155555;
D.S SD:0x10013410 %LE %LONG 0x06155555;
D.S SD:0x10004454 %LE %LONG 0x00000000;
D.S SD:0x10013454 %LE %LONG 0x00000000;
D.S SD:0x1000441c %LE %LONG 0x11111111;
D.S SD:0x1001341c %LE %LONG 0x11111111;
D.S SD:0x10004420 %LE %LONG 0x11111111;
D.S SD:0x10013420 %LE %LONG 0x11111111;
D.S SD:0x10004424 %LE %LONG 0x11111111;
D.S SD:0x10013424 %LE %LONG 0x11111111;
D.S SD:0x10004428 %LE %LONG 0x0000ffff;
D.S SD:0x10013428 %LE %LONG 0x0000ffff;
D.S SD:0x1000442c %LE %LONG 0x005500ff;
D.S SD:0x1001342c %LE %LONG 0x005500ff;
D.S SD:0x100041e0 %LE %LONG 0x3601ffff;
D.S SD:0x100131e0 %LE %LONG 0x3601ffff;
D.S SD:0x100041f8 %LE %LONG 0x0c002ec1;
D.S SD:0x100131f8 %LE %LONG 0x0c002ec1;
D.S SD:0x1000423c %LE %LONG 0x2201ffff;
D.S SD:0x1001323c %LE %LONG 0x2201ffff;
D.S SD:0x10004008 %LE %LONG 0x00406300;
D.S SD:0x10013008 %LE %LONG 0x00406300;
D.S SD:0x10004048 %LE %LONG 0x2200110d;
D.S SD:0x10013048 %LE %LONG 0x2200110d;
D.S SD:0x1000408c %LE %LONG 0x00000001;
D.S SD:0x1001308c %LE %LONG 0x00000001;
D.S SD:0x100040d8 %LE %LONG 0x00500510;
D.S SD:0x100130d8 %LE %LONG 0x00500510;
D.S SD:0x100040e4 %LE %LONG 0x00002101;
D.S SD:0x100130e4 %LE %LONG 0x00002101;
D.S SD:0x100040b8 %LE %LONG 0x99169952;
D.S SD:0x100130b8 %LE %LONG 0x99169952;
D.S SD:0x100040bc %LE %LONG 0x99109950;
D.S SD:0x100130bc %LE %LONG 0x99109950;
D.S SD:0x10004090 %LE %LONG 0x00000000;
D.S SD:0x10013090 %LE %LONG 0x00000000;
D.S SD:0x100040dc %LE %LONG 0x83200200;
D.S SD:0x100130dc %LE %LONG 0x83200200;
D.S SD:0x100040e0 %LE %LONG 0x12200200;
D.S SD:0x100130e0 %LE %LONG 0x12200200;
D.S SD:0x10004118 %LE %LONG 0x00000002;
D.S SD:0x10013118 %LE %LONG 0x00000002;
D.S SD:0x100040f0 %LE %LONG 0x10000000;
D.S SD:0x100130f0 %LE %LONG 0x10000000;
D.S SD:0x100040f4 %LE %LONG 0x01000000;
D.S SD:0x100130f4 %LE %LONG 0x01000000;
D.S SD:0x10004168 %LE %LONG 0x00000080;
D.S SD:0x10013168 %LE %LONG 0x00000080;
D.S SD:0x10004130 %LE %LONG 0x30000000;
D.S SD:0x10013130 %LE %LONG 0x30000000;
D.S SD:0x100040d8 %LE %LONG 0x00700510;
D.S SD:0x100130d8 %LE %LONG 0x00700510;
;D.S SD:0x10004004 %LE %LONG 0xf00486a3;
D.S SD:0x10004004 %LE %LONG 0xf00481a3;
D.S SD:0x10013004 %LE %LONG 0xf00486a3;
D.S SD:0x10004124 %LE %LONG 0xc0000000;
D.S SD:0x10013124 %LE %LONG 0xc0000000;
D.S SD:0x10004138 %LE %LONG 0x00000100;
D.S SD:0x10013138 %LE %LONG 0x00000100;
D.S SD:0x10004094 %LE %LONG 0x00000000;
D.S SD:0x10013094 %LE %LONG 0x00000000;
D.S SD:0x10004098 %LE %LONG 0x00000000;
D.S SD:0x10013098 %LE %LONG 0x00000000;
D.S SD:0x100041c0 %LE %LONG 0x11110000;
D.S SD:0x100131c0 %LE %LONG 0x11110000;
D.S SD:0x10004240 %LE %LONG 0x00000008;
D.S SD:0x10013240 %LE %LONG 0x00000008;
D.S SD:0x10004000 %LE %LONG 0x555804a3;
D.S SD:0x10013000 %LE %LONG 0x555804a3;
D.S SD:0x100040fc %LE %LONG 0x00020000;
D.S SD:0x100130fc %LE %LONG 0x00020000;
D.S SD:0x100041f8 %LE %LONG 0x0c002ec1;
D.S SD:0x100131f8 %LE %LONG 0x0c002ec1;
;D.S SD:0x100041ec %LE %LONG 0x10000002;
;D.S SD:0x100131ec %LE %LONG 0x10000002;
D.S SD:0x100041ec %LE %LONG 0x10101002;
D.S SD:0x100131ec %LE %LONG 0x10101002;
D.S SD:0x1000407c %LE %LONG 0xc0063281;
D.S SD:0x1001307c %LE %LONG 0xc0063281;
D.S SD:0x10004080 %LE %LONG 0x70050500;
D.S SD:0x10013080 %LE %LONG 0x70050500;
D.S SD:0x10004028 %LE %LONG 0x50200000;
D.S SD:0x10013028 %LE %LONG 0x50200000;
D.S SD:0x10004158 %LE %LONG 0x00000000;
D.S SD:0x10013158 %LE %LONG 0x00000000;
D.S SD:0x100040f4 %LE %LONG 0x01200000;
D.S SD:0x100130f4 %LE %LONG 0x01200000;
D.S SD:0x100040e4 %LE %LONG 0x00000005;
D.S SD:0x100130e4 %LE %LONG 0x00000005;
D.S SD:0x10004088 %LE %LONG 0x0000003f;
D.S SD:0x10013088 %LE %LONG 0x0000003f;
D.S SD:0x100041e4 %LE %LONG 0x00000001;
D.S SD:0x100131e4 %LE %LONG 0x00000001;
D.S SD:0x100041e4 %LE %LONG 0x00000000;
D.S SD:0x100131e4 %LE %LONG 0x00000000;
D.S SD:0x10004088 %LE %LONG 0x00ff000a;
D.S SD:0x10013088 %LE %LONG 0x00ff000a;
D.S SD:0x100041e4 %LE %LONG 0x00000001;
D.S SD:0x100131e4 %LE %LONG 0x00000001;
D.S SD:0x100041e4 %LE %LONG 0x00000000;
D.S SD:0x100131e4 %LE %LONG 0x00000000;
D.S SD:0x10004088 %LE %LONG 0x00330001;
D.S SD:0x10013088 %LE %LONG 0x00330001;
D.S SD:0x100041e4 %LE %LONG 0x00000001;
D.S SD:0x100131e4 %LE %LONG 0x00000001;
D.S SD:0x100041e4 %LE %LONG 0x00000000;
D.S SD:0x100131e4 %LE %LONG 0x00000000;
D.S SD:0x10004088 %LE %LONG 0x00060002;
D.S SD:0x10013088 %LE %LONG 0x00060002;
D.S SD:0x100041e4 %LE %LONG 0x00000001;
D.S SD:0x100131e4 %LE %LONG 0x00000001;
D.S SD:0x100041e4 %LE %LONG 0x00000000;
D.S SD:0x100131e4 %LE %LONG 0x00000000;
D.S SD:0x10004088 %LE %LONG 0x00000000;
D.S SD:0x10013088 %LE %LONG 0x00000000;
D.S SD:0x100041e4 %LE %LONG 0x00001100;
D.S SD:0x100131e4 %LE %LONG 0x00001100;
D.S SD:0x100041e4 %LE %LONG 0x00000100;
D.S SD:0x100131e4 %LE %LONG 0x00000100;
;D.S SD:0x10004110 %LE %LONG 0x00696281;
;D.S SD:0x10013110 %LE %LONG 0x00696281;
D.S SD:0x10004110 %LE %LONG 0x03696281;
D.S SD:0x10013110 %LE %LONG 0x03696281;
D.S SD:0x100040e4 %LE %LONG 0x00000001;
D.S SD:0x100130e4 %LE %LONG 0x00000001;
D.S SD:0x100041ec %LE %LONG 0x10000002;
D.S SD:0x100131ec %LE %LONG 0x10000002;
D.S SD:0x10004084 %LE %LONG 0x00000a56;
D.S SD:0x10013084 %LE %LONG 0x00000a56;
D.S SD:0x10004080 %LE %LONG 0x70050500;
D.S SD:0x10013080 %LE %LONG 0x70050500;
D.S SD:0x1000400c %LE %LONG 0x00000000;
D.S SD:0x1001300c %LE %LONG 0x00000000;
D.S SD:0x10004000 %LE %LONG 0x555804a3;
D.S SD:0x10013000 %LE %LONG 0x555804a3;
D.S SD:0x10004044 %LE %LONG 0xa8000400;
D.S SD:0x10013044 %LE %LONG 0xa80d0400;
D.S SD:0x100041e8 %LE %LONG 0x01000000;
D.S SD:0x100131e8 %LE %LONG 0x01000d20;
D.S SD:0x10004008 %LE %LONG 0x00C03200;
D.S SD:0x10013008 %LE %LONG 0x00C03200;
D.S SD:0x10004010 %LE %LONG 0x00000000;
D.S SD:0x10013010 %LE %LONG 0x00000000;
D.S SD:0x10004100 %LE %LONG 0x01008110;
D.S SD:0x10013100 %LE %LONG 0x01008110;
D.S SD:0x1000401c %LE %LONG 0x12121212;
D.S SD:0x1001301c %LE %LONG 0x12121212;
D.S SD:0x100040f8 %LE %LONG 0x00000000;
D.S SD:0x100130f8 %LE %LONG 0x00000000;
D.S SD:0x100040fc %LE %LONG 0x00020000;
D.S SD:0x100130fc %LE %LONG 0x00020000;
D.S SD:0x100041dc %LE %LONG 0xd32e3840;
D.S SD:0x100131dc %LE %LONG 0xd3623840;
D.S SD:0x10004348 %LE %LONG 0x00010008;
D.S SD:0x10013348 %LE %LONG 0x00010008;
D.S SD:0x1020e03c %LE %LONG 0x01010000;
D.S SD:0x1021603c %LE %LONG 0x01010000;
D.S SD:0x1020e040 %LE %LONG 0x00000040;
D.S SD:0x10216040 %LE %LONG 0x00000040;
D.S SD:0x1020e03c %LE %LONG 0x01010000;
D.S SD:0x1021603c %LE %LONG 0x01010000;
D.S SD:0x1020e040 %LE %LONG 0x00000040;
D.S SD:0x10216040 %LE %LONG 0x00000040;
D.S SD:0x10004044 %LE %LONG 0xa8000480;
D.S SD:0x10013044 %LE %LONG 0xa80d0480;
D.S SD:0x10004048 %LE %LONG 0x2200110d;
D.S SD:0x10013048 %LE %LONG 0x2200110d;




































